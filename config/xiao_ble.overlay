/ {
    chosen {
        zmk,kscan = &kscan0;
    };

    kscan0: kscan_0 {
        compatible = "zmk,kscan-gpio-direct";
        input-gpios
            = <&gpio0 2  (GPIO_ACTIVE_LOW | GPIO_PULL_UP)>
            , <&gpio0 3  (GPIO_ACTIVE_LOW | GPIO_PULL_UP)>
            , <&gpio0 28 (GPIO_ACTIVE_LOW | GPIO_PULL_UP)>
            , <&gpio0 29 (GPIO_ACTIVE_LOW | GPIO_PULL_UP)>
            ;
    };
};